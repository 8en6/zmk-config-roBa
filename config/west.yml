## config/west.yml
```yaml
manifest:
  remotes:
    - name: zmkfirmware
      url-base: https://github.com/zmkfirmware
    - name: kumamuk-git
      url-base: https://github.com/kumamuk-git
    - name: 8en6
      url-base: https://github.com/8en6
    - name: kot149
      url-base: https://github.com/kot149
  projects:
    - name: zmk
      remote: zmkfirmware
      revision: v0.3-branch
      import: app/west.yml
    - name: zmk-pmw3610-driver
      remote: kumamuk-git
      revision: main
    - name: zmk-input-processor-scroll-inertia
      remote: 8en6
      revision: main
    - name: zmk-scroll-snap
      remote: kot149
      revision: v1
  self:
    path: config
```
